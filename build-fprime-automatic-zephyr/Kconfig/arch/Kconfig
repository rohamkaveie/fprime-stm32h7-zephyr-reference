## build-fprime-automatic-zephyr/Kconfig/arch/Kconfig
```kconfig
# Load Zephyr Arch Kconfig descriptions.
osource "/workspace/lib/zephyr-workspace/zephyr/arch/rx/Kconfig"
osource "/workspace/lib/zephyr-workspace/zephyr/arch/x86/Kconfig"
osource "/workspace/lib/zephyr-workspace/zephyr/arch/xtensa/Kconfig"
osource "/workspace/lib/zephyr-workspace/zephyr/arch/sparc/Kconfig"
osource "/workspace/lib/zephyr-workspace/zephyr/arch/riscv/Kconfig"
osource "/workspace/lib/zephyr-workspace/zephyr/arch/posix/Kconfig"
osource "/workspace/lib/zephyr-workspace/zephyr/arch/mips/Kconfig"
osource "/workspace/lib/zephyr-workspace/zephyr/arch/arm64/Kconfig"
osource "/workspace/lib/zephyr-workspace/zephyr/arch/arm/Kconfig"
osource "/workspace/lib/zephyr-workspace/zephyr/arch/arc/Kconfig"
```

## build-fprime-automatic-zephyr/Kconfig/boards/Kconfig.defconfig
```kconfig
# Load Zephyr board defconfig descriptions.
osource "/workspace/lib/zephyr-workspace/zephyr/boards/st/nucleo_h723zg/Kconfig.defconfig"
```

## build-fprime-automatic-zephyr/Kconfig/boards/Kconfig.nucleo_h723zg
```kconfig
# Load board Kconfig descriptions.
osource "/workspace/lib/zephyr-workspace/zephyr/boards/st/nucleo_h723zg/Kconfig.nucleo_h723zg"
```

## build-fprime-automatic-zephyr/Kconfig/boards/Kconfig.sysbuild
```kconfig
# Load Sysbuild board Kconfig descriptions.
osource "/workspace/lib/zephyr-workspace/zephyr/boards/st/nucleo_h723zg/Kconfig.sysbuild"
```
